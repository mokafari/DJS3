## main/Kconfig.projbuild
```kconfig
menu "DJ Deck Configuration"

    config HW_TEST_MODE
        bool "Hardware Test Mode"
        default n
        help
            Enable hardware test mode. When enabled, the firmware will run
            hardware tests instead of the normal DJ deck application.
            Use with dev.py --test-hw

endmenu
```

## sdkconfig.defaults
```kconfig
# ESP32-S3 Target Configuration
CONFIG_IDF_TARGET="esp32s3"
CONFIG_IDF_TARGET_ESP32S3=y

# CPU Configuration
CONFIG_ESP32S3_DEFAULT_CPU_FREQ_240=y
CONFIG_ESP32S3_DEFAULT_CPU_FREQ_MHZ=240

# Flash Configuration
CONFIG_ESPTOOLPY_FLASHSIZE_4MB=y
CONFIG_ESPTOOLPY_FLASHSIZE="4MB"

# Partition Table
CONFIG_PARTITION_TABLE_SINGLE_APP=y
CONFIG_PARTITION_TABLE_CUSTOM_FILENAME="partitions.csv"

# PSRAM Configuration (8MB OSPI PSRAM)
CONFIG_SPIRAM=y
CONFIG_SPIRAM_MODE_OCT=y
CONFIG_SPIRAM_SPEED_80M=y
CONFIG_SPIRAM_USE_MALLOC=y
CONFIG_SPIRAM_MALLOC_ALWAYSINTERNAL=16384
CONFIG_SPIRAM_USE_CAPS_ALLOC=y
CONFIG_SPIRAM_MEMTEST=y

# PSRAM Size (8MB = 8388608 bytes)
CONFIG_SPIRAM_SIZE=8388608

# Cache Configuration for PSRAM
CONFIG_SPIRAM_CACHE_WORKAROUND=y

# Serial Configuration
CONFIG_ESP_CONSOLE_UART_DEFAULT=y
CONFIG_ESP_CONSOLE_UART_BAUDRATE_115200=y
CONFIG_ESP_CONSOLE_UART_BAUDRATE=115200

# Component Configuration
CONFIG_SPI_MASTER_IN_IRAM=y
CONFIG_SPI_MASTER_ISR_IN_IRAM=y
CONFIG_SPI_SLAVE_IN_IRAM=y
CONFIG_SPI_SLAVE_ISR_IN_IRAM=y

# LEDC Configuration (for backlight PWM)
CONFIG_LEDC_CTRL_FUNC_IN_IRAM=y
CONFIG_LEDC_SUPPRESS_DEPRECATE_WARN=y

# I2C Configuration (for GT911 touch if used)
CONFIG_I2C_ISR_IRAM_SAFE=y

# FreeRTOS Configuration
CONFIG_FREERTOS_HZ=1000

# Log Configuration
CONFIG_LOG_DEFAULT_LEVEL_INFO=y
CONFIG_LOG_DEFAULT_LEVEL=3

# Memory Configuration
CONFIG_HEAP_POISONING_COMPREHENSIVE=y
CONFIG_HEAP_TRACING_OFF=y
# Increase threshold for PSRAM allocation (reduce DRAM usage)
CONFIG_SPIRAM_MALLOC_ALWAYSINTERNAL=8192
# Enable more aggressive PSRAM usage
CONFIG_SPIRAM_TRY_ALLOCATE_WIFI_LWIP=y

# Compiler Options
CONFIG_COMPILER_OPTIMIZATION_SIZE=y
CONFIG_COMPILER_CXX_EXCEPTIONS=n
# Reduce DRAM usage by optimizing memory layout
CONFIG_ESP32S3_DATA_CACHE_64KB=y
CONFIG_ESP32S3_INSTRUCTION_CACHE_64KB=y

# NVS Configuration
CONFIG_NVS_ENCRYPTION=n

# WiFi Configuration (disabled for minimal build)
CONFIG_ESP32_WIFI_STATIC_RX_BUFFER_NUM=10
CONFIG_ESP32_WIFI_DYNAMIC_RX_BUFFER_NUM=32

# Bluetooth Configuration (disabled for minimal build)
CONFIG_BT_ENABLED=n

# mDNS Configuration
CONFIG_MDNS_MAX_SERVICES=10

# HTTP Server Configuration
CONFIG_HTTPD_MAX_REQ_HDR_LEN=1024
CONFIG_HTTPD_MAX_URI_LEN=512

# SPIFFS Configuration (if needed)
CONFIG_SPIFFS_MAX_PARTITIONS=3

# FatFS Configuration (if needed)
CONFIG_FATFS_LONG_FILENAMES=y
CONFIG_FATFS_LONG_FILENAME_HEAP=y

# USB Host Configuration
CONFIG_USB_HOST_ENABLE=y
CONFIG_USB_HOST_CONTROL_TRANSFER_MAX_SIZE=512
CONFIG_USB_HOST_HW_BUFFER_BIAS_BALANCED=y

# LVGL Configuration (if needed later)
CONFIG_LV_COLOR_DEPTH_16=y
CONFIG_LV_COLOR_16_SWAP=n
```

## test_app/sdkconfig.defaults
```kconfig
# Test App SDK Configuration
# Minimal configuration for running tests

# Target: ESP32-S3
CONFIG_IDF_TARGET="esp32s3"

# Use PSRAM
CONFIG_ESP32S3_SPIRAM_SUPPORT=y
CONFIG_SPIRAM=y
CONFIG_SPIRAM_MODE_OCT=y

# Logging
CONFIG_LOG_DEFAULT_LEVEL_INFO=y

# Unity test framework
CONFIG_UNITY_ENABLE_FLOAT=y
CONFIG_UNITY_ENABLE_DOUBLE=y
```
